/*
 * Copyright (c) 2020 The ZMK Contributors
 *
 * SPDX-License-Identifier: MIT
 */

#include <behaviors.dtsi>
#include <dt-bindings/zmk/keys.h>
#include <dt-bindings/zmk/bt.h>

#include "../zmk-nodefree-config/helper.h"
#include "../zmk-nodefree-config/keypos_def/keypos_42keys.h"
#include "../zmk-nodefree-config/international_chars/danish.dtsi"

#define ___ &trans

#define DEF 0  // layer shortcuts, must match order in which they are defined below
#define LOW 1
#define RSE 2
/*#define MOV 3*/

/* custom behaviors */
/* custom behaviors DONE*/
ZMK_LAYER
(
   default_layer,
// |---------|---------|---------|---------|---------|---------|----|---------|---------|---------|---------|---------|---------|
// |   TAB   |   Q     |    W    |    E    |    R    |    T    |    |    Y    |    U    |    I    |    O    |    P    |    Å    |
   &kp TAB   &kp Q     &kp W     &kp E     &kp R     &kp T          &kp Y     &kp U     &kp I     &kp O     &kp P     &dk_aa
// |    CTRL |   A     |   S     |   D     |   F     |   G     |    |   H     |   J     |   K     |   L     |   Ø     |   Æ     |
   &kp LCTRL &kp A     &kp S     &kp D     &kp F     &kp G          &kp H     &kp J     &kp K     &kp L     &dk_oe    &dk_ae
// |    SHFT |   Z     |   X     |   C     |   V     |   B     |    |   N     |   M     |   ,     |   .     |   -     |  RSHFT  |
   &kp LSHFT &kp Z     &kp X     &kp C     &kp V     &kp B          &kp N     &kp M     &kp COMMA &kp DOT   &kp MINUS &kp RSHFT
//                    |    GUI |      |   ENT |   |    SPC  |      |    ALT |
                      &kp LGUI &mo 1  &kp RET     &kp SPACE &mo 2  &kp RALT
)

ZMK_LAYER
(
   lower_layer,
// |---------_|---------|---------|---------|---------|---------|----_---|---------|---------|---------|---------|---------_-|---------|
// |   TAB    |   F1    |   F2    |   F3    |   F4    |   F5    |        |   F6    |   F7    |   F8    |   F9    |   F10     |   F11   |
   &kp TAB    &kp F1    &kp F2    &kp F3    &kp F4    &kp F5             &kp F6    &kp F7    &kp F8    &kp F9    &kp F10     &kp F11
// | BTCLR    |   "|"   |    `    |   $     |   ^     |   ~     |        |         |   INS   |   HM    |   PUp   |   PrS     |   F12   |
   &bt BT_CLR &kp PIPE  &kp GRAVE &kp DLLR  &kp CARET &kp TILDE             ___    &kp INS   &kp HOME  &kp PG_UP &kp PSCRN      &kp F12
// |   SHFT   |   <     |   >     |   BT1   |   BT2   |   BT3   |        |         |   DEL   |   END   |   PDw   |   CNT     |   ESC   |
   &kp LSHFT  &kp LT    &kp GT    &bt BT_SEL 0 &bt BT_SEL 1 &bt BT_SEL 2    ___    &kp DEL   &kp END   &kp PG_DN &kp K_CMENU &kp ESC
//                    |    GUI |      |   ENT |   |    SPC  |      |    ALT |
                      &kp LGUI   ___  &kp RET     &kp SPACE   ___  &kp RALT
)

ZMK_LAYER
(
   raise_layer, //Maybe use KP_N# instead of N# & KP_PLUS for PLUS etc
// |---------|---------|---------|---------|---------|---------|----|---------|---------|---------|---------|---------|---------|
// |    TAB  |   !     |  "      |   #     |   (     |   )     |    |   =     |   /     |   7     |   8     |    9    |   -     |
   &kp  TAB  &kp EXCL  &kp DQT   &kp HASH  &kp LPAR  &kp RPAR       &kp EQUAL &kp FSLH  &kp N7    &kp N8    &kp  N9   &kp MINUS
// |    CTRL |   %     |   &     |   @     |   [     |   ]     |    |         |   *     |   4     |   5     |    6    |   +     |
   &kp LCTRL &kp PRCNT &kp AMPS  &kp AT    &kp LBKT  &kp RBKT           ___   &kp STAR  &kp N4    &kp N5    &kp  N6   &kp PLUS
// |    SHFT |   ?     |   \     |   '     |   {     |   }     |    |         |   0     |   1     |   2     |    3    |   ,     |
   &kp LSHFT &kp QMARK &kp BSLH  &kp SQT   &kp LBRC  &kp RBRC           ___   &kp N0    &kp N1    &kp N2    &kp N3    &kp COMMA
//                    |    GUI |      |   ENT |   |    SPC  |      |    ALT |
                      &kp LGUI   ___  &kp RET     &kp SPACE   ___  &kp RALT
)
//Will keep nordic letters æøå in same pos as in nordic kb. means backspace is not in base, but in regular position in raised and lowered
//semicolon is shifted komma
//start parenthises ({[ is same finger, as is end )]} 
// EXCEPT GT AND LT
// TODO: ARROWS , LOCKS? umlaut?, GRAVE `, ´,