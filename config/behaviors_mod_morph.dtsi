// Behaviors to support US like symbols when host layoust is SI
//salut: bzgec

// + ?
no_plus: no-plus-qmark {
  compatible = "zmk,behavior-mod-morph";
  label = "NO_PLUS_QMARK";
  #binding-cells = <0>;
  bindings = <&kp NO_PLUS>, <&kp NO_QUES>;
  mods = <(MOD_LSFT|MOD_RSFT)>;

};
// / \
no_fslh: no-slash-bsls {
  compatible = "zmk,behavior-mod-morph";
  label = "NO_SLASH_BSLS";
  #binding-cells = <0>;
  bindings = <&kp NO_SLSH>, <&kp NO_BSLS>;
  mods = <(MOD_LSFT|MOD_RSFT)>;
};

// / <
no_bsdl: no-bspc-del {
  compatible = "zmk,behavior-mod-morph";
  label = "NO_BSPC-DEL";
  #binding-cells = <0>;
  bindings = <&kp BSPC>, <&kp DEL>;
  mods = <(MOD_LSFT|MOD_RSFT)>;
};
